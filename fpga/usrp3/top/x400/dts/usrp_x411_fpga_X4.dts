/*
 * Copyright 2022 Piotr Krysik <ptrkrysik@gmail.com>
 *
 * SPDX-License-Identifier: LGPL-3.0-or-later
 */

/dts-v1/;
/plugin/;

#include "x411-version-info.dtsi"

#include "x411-fpga.dtsi"

#include "x4xx-common.dtsi"

#include "x410-rfdc.dtsi"

#include "x4xx-dma.dtsi"

#include "x4xx-10gbe-port0-x4.dtsi"
